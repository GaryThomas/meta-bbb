## conf/bblayers.conf.sample
```bitbake
# LAYER_CONF_VERSION is increased each time build/conf/bblayers.conf
# changes incompatibly
LCONF_VERSION = "6"

BBPATH = "${TOPDIR}"
BBFILES ?= ""

BBLAYERS ?= " \
  ##OEROOT##/meta \
  ##OEROOT##/meta-bbb \
  ##OEROOT##/meta-ti \
  ##OEROOT##/meta-yocto \
  "
BBLAYERS_NON_REMOVABLE ?= " \
  ##OEROOT##/meta \
  ##OEROOT##/meta-yocto \
  "
```

## conf/layer.conf
```bitbake
# We have a conf and classes directory, add to BBPATH
BBPATH =. "${LAYERDIR}:"

# We have recipes-* directories, add to BBFILES
BBFILES += "${LAYERDIR}/recipes-*/*/*.bb \
            ${LAYERDIR}/recipes-*/*/*.bbappend"

BBFILE_COLLECTIONS += "bbb"
BBFILE_PATTERN_bbb = "^${LAYERDIR}/"
BBFILE_PRIORITY_bbb = "5"

# This should only be incremented on significant changes that will
# cause compatibility issues with other layers
LAYERVERSION_bbb = "2"

LAYERDEPENDS_bbb = "yocto"
```
